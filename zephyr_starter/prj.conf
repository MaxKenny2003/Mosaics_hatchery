## CMakeLists.txt
```
cmake_minimum_required(VERSION 3.28.0)

# Tell Cmake we have made our own custom .overlay file
# Apparently we don't need this if the name is app.overlay
#set(DTC_OVERLAY_FILE "${CMAKE_CURRENT_LIST_DIR}/app.overlay")
# grabs the device tree file for the board we are trying to use
set(BOARD rpi_pico/rp2040/w) 

message(STATUS "Overlay path: ${DTC_OVERLAY_FILE}")
message(STATUS "Exists: ")
if(EXISTS "${DTC_OVERLAY_FILE}")
  message(STATUS "  yes")
else()
  message(STATUS "  NO")
endif()

find_package(Zephyr REQUIRED HINTS $ENV{ZEPHYR_BASE})

project(zephyr_starter)

target_sources(app PRIVATE src/main.cpp)
```

## prj.conf
```kconfig
CONFIG_GPIO=y
CONFIG_NETWORKING=y
CONFIG_NET_IPV4=y
CONFIG_NET_DHCPV4=y
CONFIG_NET_L2_ETHERNET=y
CONFIG_WIFI=y
CONFIG_NET_MGMT_EVENT=y
CONFIG_NET_MGMT_EVENT_QUEUE_SIZE=16
CONFIG_NET_MGMT_EVENT_QUEUE_TIMEOUT=5000
CONFIG_TEST_RANDOM_GENERATOR=y
CONFIG_MAIN_STACK_SIZE=4096
CONFIG_NET_TX_STACK_SIZE=2048
CONFIG_NET_RX_STACK_SIZE=2048
```

## src/main.cpp
```c
#include <zephyr/kernel.h>
#include <zephyr/drivers/gpio.h>

#define LED0_NODE DT_ALIAS(led0)    // Have to use macros and led0 is an alias
static const struct gpio_dt_spec led = GPIO_DT_SPEC_GET(LED0_NODE, gpios);  // GPIO structure`
int main()
{
    int ret;

    ret = gpio_pin_configure_dt(&led, GPIO_OUTPUT_INACTIVE);    // configure the gpio to be an output initially inactive
    if (ret < 0) {
        return ret;
    }

    ret = gpio_pin_set_dt(&led, 1); // Set it to 1
    if (ret < 0) {
        return ret;
    }

    while(1)
    {
        gpio_pin_toggle_dt(&led);
        k_msleep(500);
    }


    return 0;
}
```
